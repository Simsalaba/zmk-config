## config/tamagotchi/Kconfig
```kconfig
config TAMAGOTCHI_WIDGET
    bool "Tamagotchi pet widget for nice!view peripheral display"
    depends on ZMK_DISPLAY
    select LV_USE_CANVAS
```

## config/west.yml
```yaml
manifest:
  remotes:
    - name: zmkfirmware
      url-base: https://github.com/zmkfirmware
    - name: manna-harbour
      url-base: https://github.com/manna-harbour
  projects:
    - name: zmk
      remote: zmkfirmware
      revision: main
      import: app/west.yml
    - name: miryoku_zmk
      remote: manna-harbour
      revision: 559aa4beae75cb3206ab411b7da2adb9665c6896
      path: miryoku
  self:
    path: config
```
